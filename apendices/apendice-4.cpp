#define INTERVAL_MS 1000
#define ENCODER_INPUT_A 32
#define ENCODER_INPUT_B 33
#define PWM_PIN 16
#define PWM_FREQUENCY 1000
#define PWM_DUTY_CYCLE 255
#define PWM_CHANEL 0

const int resolution = 8;
int encoderChanges = 0;
unsigned long previousMillis = 0;

/*
 The following function was created based on the waveform generated by the
 encoder when the motor was rotating both clock and counter-clockwise.
 The measured waveforms were:
 
 - When rotating clockwise:
 Encoder B output generates a high-pulse before Encoder A output
 Encoder output A: ___|```|__
 Encoder output B: __|```|__
 - When rotating counter-clockwise:
 Encoder A output generates a high-pulse before Encoder B output
 Encoder output A: __|```|__
 Encoder output B: ___|```|__
*/
void onEncoderInterruption() {
    int encoderAState = digitalRead(ENCODER_INPUT_A);
    int encoderBState = digitalRead(ENCODER_INPUT_B);
    
    if (encoderAState == HIGH && encoderBState == LOW) {
        encoderChanges--;
    } else if(encoderAState == LOW && encoderBState == HIGH) {
        encoderChanges++;
    }
}
void setup() {
    Serial.begin(115200);
    attachInterrupt(digitalPinToInterrupt(ENCODER_INPUT_A), onEncoderInterruption, RISING);
    attachInterrupt(digitalPinToInterrupt(ENCODER_INPUT_B), onEncoderInterruption, RISING);

    ledcSetup(PWM_CHANEL, PWM_FREQUENCY, resolution);
    ledcAttachPin(PWM_PIN, PWM_CHANEL);

    ledcWrite(0, PWM_DUTY_CYCLE); 
}
void loop() {
 unsigned long currentMillis = millis();

    if (currentMillis - previousMillis >= INTERVAL_MS) {
        previousMillis = currentMillis; 

        Serial.print("Quantidade de pulsos: ");
        Serial.println(encoderChanges);

        encoderChanges = 0;
    }
}